;TECLA 0 Y 1 PARA CAMBIAR DE CANAL
    
; PIC16F887 Configuration Bit Settings

; Assembly source line config statements

#include "p16f887.inc"

; CONFIG1
; __config 0x30F5
 __CONFIG _CONFIG1, _FOSC_INTRC_NOCLKOUT & _WDTE_OFF & _PWRTE_OFF & _MCLRE_ON & _CP_OFF & _CPD_OFF & _BOREN_OFF & _IESO_OFF & _FCMEN_OFF & _LVP_ON
; CONFIG2
; __config 0x3FFF
 __CONFIG _CONFIG2, _BOR4V_BOR40V & _WRT_OFF
 
 CBLOCK 0X21
    VARIABLE1	    ;21 de memoria de datos
    TEMPORAL	    ;22 de memoria de datos
    VAR2
    W_TEMP	    ;REGISTRO PARA GUARDAR CONTEXTO W
    STATUS_TEMP	    ;REGISTRO PARA GUARDAR CONTEXTO REGISTRO STATUS
    TMR0_CONTADOR
    INTRB0_CONTADOR
    CONTADOR_RB
    UNIDAD
    DECENA
    CENTENA
    D_CONV
    TECLA
    DATO_AD
 ENDC
 
 VAR4 EQU 0X70
 VAR5 EQU 0X71
 VAR6 EQU 0XA0
 
 ORG	0
 GOTO	INICIO
 ORG	4
;GUARDAR CONTEXTO
 MOVWF	W_TEMP
 SWAPF	STATUS,W
 MOVWF	STATUS_TEMP
 
 ;CODIGO INTERRUPCION


 BTFSC PIR1,ADIF
    GOTO  INT_AD 
 
 BTFSC INTCON,RBIF
    GOTO  INT_RB
 GOTO  FIN_INT
 
 INT_TMR0
    MOVLW   .100
    MOVWF   TMR0
    INCF    TMR0_CONTADOR,F
    BCF	    INTCON,T0IF	    ;BAJAR LA BANDERA QUE CAUSO LA INT
 GOTO FIN_INT 
 
 INT_AD
 
    MOVF    ADRESH,W
    MOVWF   PORTC	    ;CARGO LOS 8 BITS MAS SIGNIFICATIVOS DE LA CONVERSION A PORTC
    MOVWF   DATO_AD
    
    
    BANKSEL ADRESL
    BTFSC   ADRESL,7
    GOTO    ALTO_7
    GOTO    BAJO_7
BIT_6 
    BANKSEL ADRESL
    BTFSC   ADRESL,6
    GOTO    ALTO_6
    GOTO    BAJO_6
    
    
    ALTO_7
	BANKSEL	PORTA
	BSF	PORTA,7
	GOTO	BIT_6
    BAJO_7
	BANKSEL	PORTA
	BCF	PORTA,7
	GOTO	BIT_6
    ALTO_6
	BANKSEL	PORTA
	BSF	PORTA,6
	GOTO	SIGA_AD
    BAJO_6
	BANKSEL	PORTA
	BCF	PORTA,6
	GOTO	SIGA_AD
	
	
SIGA_AD

 
 GOTO	FIN_INT
 
 
 
 INT_RB0
    ANTIREBOTE
	BTFSC   PORTB,0
	GOTO    ANTIREBOTE
	INCF    INTRB0_CONTADOR,F
	BCF	INTCON,INTF
 GOTO FIN_INT 
 
 
 INT_RB
     
    BTFSC   PORTB,4
    GOTO    COLUM1
    BTFSC   PORTB,5
    GOTO    COLUM2
    BTFSC   PORTB,6
    GOTO    COLUM3
    BTFSC   PORTB,7
    GOTO    COLUM4
    GOTO    FIN_INT
    
    COLUM1
	BCF	PORTB,0
	BTFSS	PORTB,4
	    MOVLW	.7
	BSF	PORTB,0
	BCF	PORTB,1
	BTFSS	PORTB,4
	    MOVLW	.4
	BSF	PORTB,1
	BCF	PORTB,2
	BTFSS	PORTB,4
	    MOVLW	.1
	BSF	PORTB,2
	BCF	PORTB,3
	BTFSS	PORTB,4
	    MOVLW	0XA
	MOVWF	TECLA
	BSF	PORTB,3
	GOTO	ANTI_REBOTE
	
    COLUM2
	BCF	PORTB,0
	BTFSS	PORTB,5
	    MOVLW	.8
	BSF	PORTB,0
	BCF	PORTB,1
	BTFSS	PORTB,5
	    MOVLW	.5
	BSF	PORTB,1
	BCF	PORTB,2
	BTFSS	PORTB,5
	    MOVLW	.2
	BSF	PORTB,2
	BCF	PORTB,3
	BTFSS	PORTB,5
	    MOVLW	.0
	MOVWF	TECLA
	BSF	PORTB,3
	GOTO	ANTI_REBOTE
    COLUM3
	BCF	PORTB,0
	BTFSS	PORTB,6
	    MOVLW	.9
	BSF	PORTB,0
	BCF	PORTB,1
	BTFSS	PORTB,6
	    MOVLW	.6
	BSF	PORTB,1
	BCF	PORTB,2
	BTFSS	PORTB,6
	    MOVLW	.3
	BSF	PORTB,2
	BCF	PORTB,3
	BTFSS	PORTB,6
	    MOVLW	0X0B
	MOVWF	TECLA
	BSF	PORTB,3
	GOTO	ANTI_REBOTE
    COLUM4
	BCF	PORTB,0
	BTFSS	PORTB,7
	    MOVLW	0X0C;DIVISION
	BSF	PORTB,0
	BCF	PORTB,1
	BTFSS	PORTB,7
	    MOVLW	0X0D;MULTIPLICACION
	BSF	PORTB,1
	BCF	PORTB,2
	BTFSS	PORTB,7
	    MOVLW	0X0E;RESTA
	BSF	PORTB,2
	BCF	PORTB,3
	BTFSS	PORTB,7
	    MOVLW	0X0F;SUMA
	MOVWF	TECLA
	BSF	PORTB,3
	GOTO	ANTI_REBOTE
 
ANTI_REBOTE
	
    BTFSC   PORTB,4
    GOTO    ANTI_REBOTE
    BTFSC   PORTB,5
    GOTO    ANTI_REBOTE
    BTFSC   PORTB,6
    GOTO    ANTI_REBOTE
    BTFSC   PORTB,7
    GOTO    ANTI_REBOTE
	
 GOTO FIN_INT 
 ;FIN CODIGO INTERRUPCION
 
 FIN_INT
    BCF	    INTCON,RBIF
   ;RECUPERAR CONTEXTO
   SWAPF STATUS_TEMP,W
   MOVWF	STATUS		;RECUPERAMOS STATUS
   ;RECUPERAR W
   ;LA INSTRUCCION MOVF NO SE PUEDE USAR POR QUE ME ALTERA Z
   SWAPF	W_TEMP,F
   SWAPF	W_TEMP,W
   
   BCF	PIR1,ADIF	    ;BAJO LA BANDERA DE LA INTERRUPCION POR AD
   BSF   ADCON0,1	    ;INICIO UNA NUEVA CONVERSION
 RETFIE 

 INICIO
  
 ;-----------------BANCO_3----------------------------------------
    BSF STATUS,5    ;PONGO EN ALTO EL BIT #5 DEL REGISTRO STATUS
    BSF STATUS,6    ;PONGO EN ALTO EL BIT #6 DEL REGISTRO STATUS CAMBIO AL BANCO#3
   
    CLRF ANSEL	    ;DEFINIR AN(7-0) COMO DIGITAL I/O
    BSF	 ANSEL,0    ;DEFINO AN0 COMO PUERTO ANALOGICO
    BSF	 ANSEL,1    ;DEFINO AN1 COMO PUERTO ANALOGICO
    BSF  ANSEL,2    ;DEFINO AN2 COMO PUERTO ANALOGICO
    CLRF ANSELH
    BSF OPTION_REG,7 ;DESABILITO LAS RESISTENCIAS DE PULL_UP
    BCF OPTION_REG,2
    BCF OPTION_REG,1
    BSF OPTION_REG,0
    
    BCF OPTION_REG,5 ;TMR0 CON FUENTE INTERNA DE RELOJ
    BCF OPTION_REG,4 ;INC CUENTA CON FLANCO ASC O DSC?
    BCF OPTION_REG,3 ;ASIGNO PRESCALA A TMR0
    
    BSF OPTION_REG,2 ;CONFIGURACION DE LA PRESCALA
    BSF OPTION_REG,1 ;CONFIGURACION DE LA PRESCALA
    BSF OPTION_REG,0 ;CONFIGURACION DE LA PRESCALA
    
 ;-----------------BANCO_1----------------------------------------
    BCF STATUS,6    ;CAMBIO AL BANCO 1
    
    BCF	ADCON1,4    ;configuro voltage de ref del ADC
    BCF	ADCON1,5    ;configuro voltage de ref del ADC
    BCF	ADCON1,7    ;RESULTADO JUSTIFICADO A LA DERECHA
    
    CLRF TRISA	   
    BSF  TRISA,0    ;CONFIGURO EL RA0 COMO ENTRADA
    BSF  TRISA,1
    BSF  TRISA,2
    CLRF TRISC 
    MOVLW   B'11110000' ;CONFIGURO PORTB, MITAD ENTRADA MITAD SALIDA
    MOVWF   TRISB
    CLRF TRISD
    CLRF TRISE
    BCF	 OSCCON,6	;125KHZ reloj interno
    BCF	 OSCCON,5
    BSF	 OSCCON,4
    MOVLW B'11110000'
    MOVWF IOCB
    
    CLRF    PIE1
    CLRF    PIE2
    BSF	    PIE1,6	;ACTIVAR ADIE, ES DECIR ACTIVAR INTERRUPCIONES POR EL CONVERSOR AD
    
 ;------------BANCO2------------------------------------------------
    BANKSEL WDTCON
    BCF WDTCON,0	;ACTIVO EL WDT SI EL BIT DE CONFIGURACION ESTA COMO WDT_OFF
    
 ;-----------------BANCO_0----------------------------------------
    BCF STATUS,5   ;CAMBIO AL BANCO 0
    BCF STATUS,6   ;CAMBIO AL BANCO 0
    
    BSF	ADCON0,2    ;CHS=0001	EL PROGRAMA INICIA LEYENDO EL CANAL AN1
    BCF ADCON0,3    ;CHS=0001
    BCF ADCON0,4    ;CHS=0001
    BCF ADCON0,5    ;CHS=0001
    
    BCF ADCON0,6    ;SELECCION DEL RELOJ DEL CONVERSOR AD
    BSF ADCON0,7    ;SELECCION DEL RELOJ DEL CONVERSOR AD
    
    BSF ADCON0,0    ;ADON-ACTIVAR EL MODULO ADC
    
    
    CLRF PORTB	
    CLRF PORTC
    CLRF PORTD
    CLRF PORTE
 ;----------------------------------------------------------------
    
CODIGO	
MOVLW	B'00001111'
MOVWF	PORTB 

BCF INTCON,RBIF
BCF INTCON,PEIE  ;DESACTIVO INTERRUPCIONES POR PERIFERICOS
BSF INTCON,7     ;ACTIVO INTERRUPCIONES GLOBALES
BCF INTCON,T0IE
BSF INTCON,RBIE  ;ACTIVO INTERRUPCIONES POR PORTB	    
BSF INTCON,PEIE  ;ACTIVO INTERRUPCIONES POR PERIFERICOS
 
 
MOVLW	0X0F	;INICIALIZACION DE LA LCD  W= 0000 1111
CALL	COMANDO 

MOVLW	0X38	;INICIALIZACION DED LA LCD W=0X38
CALL    COMANDO 

MOVLW	"U"
CALL	DATO
 
MOVLW	"P"
CALL	DATO 

MOVLW	"T"
CALL	DATO
 
MOVLW	"C"
CALL	DATO 

MOVLW	0XC0	;cambio a la segunda linea
CALL    COMANDO  

BSF	ADCON0,1	;ACTIVAR EL CONVERSOR A/D; bit GO, AUTOMATICAMENTE EL BIT GO=0 CUANDO FINALICE LA CONVERSION
;-  -	-   -	-   -	-	-   -	-   -	-   -	-   -	-   -	-   -	-   -	-   -	-   -	-   -	-   -	-   -	-   -
REPITA 
    MOVLW   .0
    XORWF   TECLA,W
    BTFSC   STATUS,Z
    GOTO    CAMBIO_AN0
    
    MOVLW   .1
    XORWF   TECLA,W
    BTFSC   STATUS,Z
    GOTO    CAMBIO_AN1
;-  -	-   -	-   -	-	-   -	-   -	-   -	-   -	-   -	-   -	-   -	-   -	-   -	-   -	-   -	-   -	-   -     
    CAMBIO_AN0
	BCF ADCON0,2    ;CHS=0000	CAMBIO AL CANAL AN0
	BCF ADCON0,3    ;CHS=0000
	BCF ADCON0,4    ;CHS=0000
	BCF ADCON0,5    ;CHS=0000
	GOTO SIGA_CODIGO
     CAMBIO_AN1
	BSF ADCON0,2    ;CHS=0001	CAMBIO AL CANAL AN1
	BCF ADCON0,3    ;CHS=0001
	BCF ADCON0,4    ;CHS=0001
	BCF ADCON0,5    ;CHS=0001
	GOTO SIGA_CODIGO   
    CAMBIO_AN2
	BCF ADCON0,2    ;CHS=0010	CAMBIO AL CANAL AN2
	BSF ADCON0,3    ;CHS=0010
	BCF ADCON0,4    ;CHS=0010
	BCF ADCON0,5    ;CHS=0010
	GOTO SIGA_CODIGO    
    
    IMPRIMIR_MENSAJE
	MOVLW	0X01	;INICIALIZACION DED LA LCD W=0X38
	CALL    COMANDO 
	MOVLW	"H"
	CALL	DATO

	MOVLW	"O"
	CALL	DATO 

	MOVLW	"L"
	CALL	DATO

	MOVLW	"A"
	CALL	DATO 	
	
	GOTO	SIGA_CODIGO
 
SIGA_CODIGO 
    MOVF	DATO_AD,W

    CALL	BIN_BCD

    MOVLW	0X30		;SUMO .48 PARA CONVERTIR A ASCII
    ADDWF	CENTENA,W 
    CALL	DATO 

    MOVLW	0X30		;SUMO .48 PARA CONVERTIR A ASCII
    ADDWF	DECENA,W 
    CALL	DATO 

    MOVLW	.48		;SUMO .48 PARA CONVERTIR A ASCII
    ADDWF	UNIDAD,W 
    CALL	DATO  

    MOVLW	0X10		;MOVER A LA IZQUIERDA EL CURSOR
    CALL	COMANDO
    MOVLW	0X10		;MOVER A LA IZQUIERDA EL CURSOR
    CALL	COMANDO
    MOVLW	0X10		;MOVER A LA IZQUIERDA EL CURSOR
    CALL	COMANDO 
    
GOTO    REPITA	 
 

COMANDO BCF	PORTE,0		;RS=0 PARA MANDAR UN COMANDO
	GOTO	SIGALCD
DATO	BSF	PORTE,0		;RS=1 PARA MANDAR UN DATO
SIGALCD MOVWF	PORTD
	CALL	RETARDOLCD
	BSF	PORTE,1		;ENABLE=1
	CALL	RETARDOLCD	
	BCF	PORTE,1		;ENABLE=0
RETURN	
 
 
			 
BIN_BCD
    CLRF    UNIDAD
    CLRF    DECENA
    CLRF    CENTENA
    MOVWF   D_CONV
    MOVF    D_CONV,W
    BTFSC   STATUS,Z
    RETURN
   
SUME_U    
    INCF    UNIDAD,F
    MOVLW   .10
    XORWF   UNIDAD,W
    BTFSS   STATUS,Z
    GOTO    DEC_D    
    
    CLRF    UNIDAD
    INCF    DECENA,F
    MOVLW   .10
    XORWF   DECENA,W
    BTFSS   STATUS,Z
    GOTO    DEC_D
    
    CLRF    DECENA
    INCF    CENTENA,F
 
DEC_D    
    DECFSZ  D_CONV,F
    GOTO    SUME_U
    
    RETURN			    
			    	    

RETARDO_TMR0
    BCF	    INTCON,T0IF
    CLRF    TMR0
 TEST_T0
    BTFSS   INTCON,T0IF
    GOTO    TEST_T0
    
RETURN   
		    		    
	
RETARDOLCD   
	REG11 EQU 0X50
	REG21 EQU 0X51
	REG31 EQU 0X52
	MOVLW   .5
	MOVWF   REG11
REP31    MOVLW   .1
	MOVWF   REG21
REP21    MOVLW   .1
	MOVWF   REG31

REP11     CLRWDT
	DECFSZ  REG31
	GOTO    REP11
	DECFSZ  REG21
	GOTO    REP21	
	DECFSZ  REG11	;1 ciclo
	GOTO    REP31	;2 ciclos
			;125KHz/4=31250 instrucciones por seg
			;Tinstruccion=1/31250=32us
			;Tr=2*(Tinstruccion*3ciclos*REG1*REG2*REG3+Tinstruccion*REG3*REG2*4ciclos)
			;Tr=32us*3*50*2*2+32us*4*2*2=19.7ms
			;Tr=(((3*REG3+4)*REG2+4)*REG1+6)*Tinstruccion
RETURN			
  
 END			

