;Juan Camilo Serrano Correa
;Caracteres alfanumИricos en display, muestra la cadena de la linea 1
; 1/08/2021
    
#include "p16f887.inc"
 __CONFIG _CONFIG1, _FOSC_INTRC_NOCLKOUT & _WDTE_OFF & _PWRTE_OFF & _MCLRE_ON & _CP_OFF & _CPD_OFF & _BOREN_ON & _IESO_ON & _FCMEN_ON & _LVP_ON
 __CONFIG _CONFIG2, _BOR4V_BOR40V & _WRT_OFF
 
 CBLOCK	0X21
 CONT
 D1
 D2
 D3
 ENDC
 ORG	0
 GOTO	INICIO
 ORG	10
 INICIO
;PASOS PARA CONFIGURAR PORTB COMO i/o INPUT;;;;;;;;;
BSF STATUS,5
BSF STATUS,6  ;11
CLRF ANSEL;CLEAR todos los bits; EN 0 LOS PINES SON DE SALIDA
CLRF ANSELH
CLRF TRISB ;out
COMF TRISB ;in
BSF OPTION_REG,7; DESABILITA RESISTENCIA PULLUP
BSF INTCON,7; DESABILITA INTERRUPCIONES
;PUERTO D OUTPUT;;;;;;;;;;;;;;;;;;;;;;;;;;;;;;;;;;;;
BCF STATUS,6 ;01
CLRF TRISC
CLRF TRISD
CLRF TRISA
COMF TRISA
CLRF TRISE
BCF STATUS,5;00
CLRF PORTC
CLRF PORTD
CLRF PORTA
CLRF PORTE
BSF PORTE,0;LED ON, CONFIRMA ENCENDIDO DEL PIC
LOOP
 BTFSS	PORTB,7
 GOTO	LOOP
 CALL	LOAD_DATA ;Antirebote__  XD	
 CALL	DELAY
 BTFSS	PORTB,7
 GOTO LOOP
 MOVF   CONT,W
 CALL	DISPLAY
 MOVWF PORTC
 INCF CONT,F
 BTFSS CONT,4  ;IF (CONT=24) CONT=0 ELSE CONTINUE
 GOTO LOOP
 BTFSS CONT,3
GOTO LOOP
 CLRF CONT
 GOTO LOOP
DISPLAY
    ADDWF PCL,F		;24				       ;   S     E    R   R     A   N	O	    C   O   R     R   E	A
    DT 0X0E,0X3E,0X77,0X37,0X39,0X77,0X37,0X30,0X38,0X3F,0X6D,0X79,0X31,0X31,0X77,0X37,0X3F,0X00,0X39,0X3F,0X31,0X31,0X79,0X77
    RETURN
    
DELAY;200ms
DECFSZ	D1, F
GOTO	$+2
DECFSZ	D2, F
GOTO	$+2
DECFSZ	D3, F
GOTO	DELAY
nop
RETURN
LOAD_DATA
MOVLW	0x36
MOVWF	D1
MOVLW	0xE0
MOVWF	D2
MOVLW	0x01
MOVWF	D3  
 RETURN
END