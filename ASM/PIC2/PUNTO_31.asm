;   JUAN CAMILO SERRANO CORREA			201621366
#include "p16f887.inc"
; CONFIG1
; __config 0x30F5
 __CONFIG _CONFIG1, _FOSC_INTRC_NOCLKOUT & _WDTE_OFF & _PWRTE_OFF & _MCLRE_ON & _CP_OFF & _CPD_OFF & _BOREN_OFF & _IESO_OFF & _FCMEN_OFF & _LVP_ON
; CONFIG2
; __config 0x3FFF
 __CONFIG _CONFIG2, _BOR4V_BOR40V & _WRT_OFF
 
 CBLOCK 0X21
    VARIABLE1	    ;21 de memoria de datos
    TEMPORAL	    ;22 de memoria de datos
    VAR1
    VAR2
    VAR3
    D1
    D2
    OFFSET
    W_TEMP	    ;REGISTRO PARA GUARDAR CONTEXTO W
    STATUS_TEMP	    ;REGISTRO PARA GUARDAR CONTEXTO REGISTRO STATUS
    TMR0_CONTADOR
    INTRB0_CONTADOR
    CONTADOR_RB
    UNIDAD
    DECENA
    CENTENA
    D_CONV
    TECLA
    ZERO
 ENDC
 
 ORG	0
 GOTO	INICIO
 ORG	4
;; CLRF     VAR1
;; CLRF	  VAR2
;; CLRF	  VAR3
;; CLRF	  ZERO
;GUARDAR CONTEXTO
 MOVWF	W_TEMP
 SWAPF	STATUS,W
 MOVWF	STATUS_TEMP
 

; BTFSC INTCON,RBIF ;Interupcion portB?
;    GOTO  INT_RB
; GOTO  FIN_INT
 
 INT_TMR0
    MOVLW   .100
    MOVWF   TMR0
    INCF    TMR0_CONTADOR,F
    BCF	    INTCON,T0IF	    ;BAJAR LA BANDERA QUE CAUSO LA INT
 GOTO FIN_INT 
 
 
 INT_RB0
    ANTIREBOTE
	BTFSC   PORTB,0
	GOTO    ANTIREBOTE
	INCF    INTRB0_CONTADOR,F
	BCF	INTCON,INTF
 GOTO FIN_INT 
 
 
 INT_RB
     
    BTFSC   PORTB,4
    GOTO    COLUM1
    BTFSC   PORTB,5
    GOTO    COLUM2
    BTFSC   PORTB,6
    GOTO    COLUM3
    BTFSC   PORTB,7
    GOTO    COLUM4
    GOTO    FIN_INT
    
    COLUM1
	BCF	PORTB,0
	BTFSC	PORTB,4
	    GOTO $+5
	    MOVLW	0X07		
	    MOVWF	TEMPORAL
	    MOVLW	0X37		;7  SUMO .48 PARA CONVERTIR A ASCII
	    CALL	DATO 
	BSF	PORTB,0
	BCF	PORTB,1
	BTFSC	PORTB,4
	    GOTO $+5
	    MOVLW	0X04	
	    MOVWF	TEMPORAL
	    MOVLW	0X34		;4  SUMO .48 PARA CONVERTIR A ASCII
	    CALL	DATO
	BSF	PORTB,1
	BCF	PORTB,2
	BTFSC	PORTB,4
	    GOTO $+5
	    MOVLW	0X01		
	    MOVWF	TEMPORAL
	    MOVLW	0X31		;1  SUMO .48 PARA CONVERTIR A ASCII
	    CALL	DATO
	BSF	PORTB,2
	BCF	PORTB,3
	BTFSC	PORTB,4
	    GOTO $+3
	    MOVLW	0X0E	;Muestro info
	    CALL    COMANDO  

	MOVWF	TECLA
	BSF	PORTB,3
	GOTO	ANTI_REBOTE
	
    COLUM2
	BCF	PORTB,0
	BTFSC	PORTB,5
	    GOTO $+5
	    MOVLW	0X08		
	    MOVWF	TEMPORAL
	    MOVLW	0X38		;8  SUMO .48 PARA CONVERTIR A ASCII
	    CALL	DATO
	    
	BSF	PORTB,0
	BCF	PORTB,1
	BTFSC	PORTB,5
	    GOTO $+5
	    MOVLW	0X05		
	    MOVWF	TEMPORAL
	    MOVLW	0X35		;5  SUMO .48 PARA CONVERTIR A ASCII
	    CALL	DATO
	    
	BSF	PORTB,1
	BCF	PORTB,2
	BTFSC	PORTB,5
	    GOTO $+5
	    MOVLW	0X02		
	    MOVWF	TEMPORAL
	    MOVLW	0X32		;2  SUMO .48 PARA CONVERTIR A ASCII
	    CALL	DATO
	    
	BSF	PORTB,2
	BCF	PORTB,3
	BTFSC	PORTB,5
	    GOTO $+5
	    MOVLW	0X00		
	    MOVWF	TEMPORAL
	    MOVLW	0X30		;0  SUMO .48 PARA CONVERTIR A ASCII	
	    CALL	DATO		
	    
	MOVWF	TECLA
	BSF	PORTB,3
	GOTO	ANTI_REBOTE
    COLUM3
	BCF	PORTB,0
	BTFSC	PORTB,6
	    GOTO $+5
	    MOVLW	0X09		
	    MOVWF	TEMPORAL
	    MOVLW	0X39		;9   SUMO .48 PARA CONVERTIR A ASCII
	    CALL	DATO
	    
	BSF	PORTB,0
	BCF	PORTB,1
	BTFSC	PORTB,6
	    GOTO $+5
	    MOVLW	0X06		
	    MOVWF	TEMPORAL
	    MOVLW	0X36		;6  SUMO .48 PARA CONVERTIR A ASCII
	    CALL	DATO
	    
	BSF	PORTB,1
	BCF	PORTB,2
	BTFSC	PORTB,6
	    GOTO $+5
	    MOVLW	0X03
	    MOVWF	TEMPORAL
	    MOVLW	0X33		;3  SUMO .48 PARA CONVERTIR A ASCII
	    CALL	DATO
	    
	BSF	PORTB,2
	BCF	PORTB,3
	BTFSC	PORTB,6
	    GOTO $+9
	    MOVF	TECLA,W
	    MOVLW	0X01	;LIMPIA PANTALLA	
	    CALL	COMANDO
	    MOVLW	0X08	;off
	    CLRF	VAR1
	    CLRF	VAR2
	    CLRF	VAR3
	    CALL    COMANDO 
	    
	MOVWF	TECLA
	BSF	PORTB,3
	GOTO	ANTI_REBOTE
    COLUM4
	BCF	PORTB,0
	BTFSC	PORTB,7
	    GOTO $+5
	    MOVLW	0X0A
	    MOVWF	TEMPORAL
	    MOVLW	0X41		;LETRA	A
	    CALL	DATO
	   
	BSF	PORTB,0
	BCF	PORTB,1
	BTFSC	PORTB,7
	    GOTO $+5
	    MOVLW	0X0B
	    MOVWF	TEMPORAL
	    MOVLW	0X42		;LETRA	B
	    CALL	DATO
	    
	BSF	PORTB,1
	BCF	PORTB,2
	BTFSC	PORTB,7
	    GOTO $+5
	    MOVLW	0X0C
	    MOVWF	TEMPORAL
	    MOVLW	0X43		;LETRA	C
	    CALL	DATO
	    
	BSF	PORTB,2
	BCF	PORTB,3
	BTFSC	PORTB,7
	    GOTO $+5
	    MOVLW	0X0D
	    MOVWF	TEMPORAL
	    MOVLW	0X44		;LETRA	D
	    CALL	DATO
	    
	MOVWF	TECLA
	BSF	PORTB,3
	GOTO	ANTI_REBOTE
 
ANTI_REBOTE
	
    BTFSC   PORTB,4
    GOTO    ANTI_REBOTE
    BTFSC   PORTB,5
    GOTO    ANTI_REBOTE
    BTFSC   PORTB,6
    GOTO    ANTI_REBOTE
    BTFSC   PORTB,7
    GOTO    ANTI_REBOTE
	
 GOTO FIN_INT 
 ;FIN CODIGO INTERRUPCION
 
 FIN_INT
    BCF	    INTCON,RBIF
   ;RECUPERAR CONTEXTO
   SWAPF STATUS_TEMP,W
   MOVWF	STATUS		;RECUPERAMOS STATUS
   ;RECUPERAR W
   ;LA INSTRUCCION MOVF NO SE PUEDE USAR POR QUE ME ALTERA Z
   SWAPF	W_TEMP,F
   SWAPF	W_TEMP,W
 
 RETFIE 

 INICIO
  
 ;-----------------BANCO_3----------------------------------------
    BSF STATUS,5    ;PONGO EN ALTO EL BIT #5 DEL REGISTRO STATUS
    BSF STATUS,6    ;PONGO EN ALTO EL BIT #6 DEL REGISTRO STATUS CAMBIO AL BANCO#3
   
    CLRF ANSEL	    ;DEFINIR AN(7-0) COMO DIGITAL I/O
    BSF	 ANSEL,1    ;DEFINO AN1 COMO PUERTO ANALOGICO
    CLRF ANSELH
    BSF OPTION_REG,7 ;DESABILITO LAS RESISTENCIAS DE PULL_UP
    BCF OPTION_REG,2
    BCF OPTION_REG,1
    BSF OPTION_REG,0
    
    BCF OPTION_REG,5 ;TMR0 CON FUENTE INTERNA DE RELOJ
    BCF OPTION_REG,4 ;INC CUENTA CON FLANCO ASC O DSC?
    BCF OPTION_REG,3 ;ASIGNO PRESCALA A TMR0
    
    BSF OPTION_REG,2 ;CONFIGURACION DE LA PRESCALA
    BSF OPTION_REG,1 ;CONFIGURACION DE LA PRESCALA
    BSF OPTION_REG,0 ;CONFIGURACION DE LA PRESCALA
    
 ;-----------------BANCO_1----------------------------------------
    BCF STATUS,6    ;CAMBIO AL BANCO 1
    
    BCF	ADCON1,4    ;configuro voltage de ref del ADC
    BCF	ADCON1,5    ;configuro voltage de ref del ADC
    BSF	ADCON1,7    ;RESULTADO JUSTIFICADO A LA DERECHA
    
    CLRF TRISA	   
    BSF  TRISA,0    ;CONFIGURO EL RA0 COMO ENTRADA
    BSF  TRISA,1
    BSF  TRISA,2
    CLRF TRISC 
    MOVLW   B'11110000' ;CONFIGURO PORTB, MITAD ENTRADA MITAD SALIDA
    MOVWF   TRISB
    CLRF TRISD
    CLRF TRISE
    BCF	 OSCCON,6	;125KHZ reloj interno
    BCF	 OSCCON,5
    BSF	 OSCCON,4
    MOVLW B'11110000'
    MOVWF IOCB
 ;------------BANCO2------------------------------------------------
    BANKSEL WDTCON
    BCF WDTCON,0	;ACTIVO EL WDT SI EL BIT DE CONFIGURACION ESTA COMO WDT_OFF
    
 ;-----------------BANCO_0----------------------------------------
    BCF STATUS,5   ;CAMBIO AL BANCO 0
    BCF STATUS,6   ;CAMBIO AL BANCO 0
    
    BSF	ADCON0,2    ;CHS=0001
    BCF ADCON0,3    ;CHS=0001
    BCF ADCON0,4    ;CHS=0001
    BCF ADCON0,5    ;CHS=0001
    
    BCF ADCON0,6    ;SELECCION DEL RELOJ DEL CONVERSOR AD
    BCF ADCON0,7    ;SELECCION DEL RELOJ DEL CONVERSOR AD
    
    BSF ADCON0,0    ;ADON-ACTIVAR EL MODULO ADC
    
    
    CLRF PORTB	
    CLRF PORTC
    CLRF PORTD
    CLRF PORTE
 ;----------------------------------------------------------------
 ORG 0X800    
CODIGO	
MOVLW	B'00001111'
MOVWF	PORTB 

BCF INTCON,RBIF
BCF INTCON,PEIE  ;DESACTIVO INTERRUPCIONES POR PERIFERICOS
BSF INTCON,7     ;ACTIVO INTERRUPCIONES GLOBALES
BCF INTCON,T0IE
BSF INTCON,RBIE  ;ACTIVO INTERRUPCIONES POR PORTB	    
 
MOVLW	0X0F	;INICIALIZACION DE LA LCD  W= 0000 1111
 
;CALL	COMANDO  
MOVWF	OFFSET
MOVLW HIGH COMANDO
MOVWF	PCLATH
MOVF 	OFFSET,W
CALL	COMANDO
CLRF	PCLATH 

 
MOVLW	0X38	;INICIALIZACION DED LA LCD W=0X38
;CALL    COMANDO 
 MOVWF	OFFSET
MOVLW HIGH COMANDO
MOVWF	PCLATH
MOVF 	OFFSET,W
CALL	COMANDO
CLRF	PCLATH 
 
MOVLW	0X08	;off
;CALL    COMANDO  
 MOVWF	OFFSET
MOVLW HIGH COMANDO
MOVWF	PCLATH
MOVF 	OFFSET,W
CALL	COMANDO
CLRF	PCLATH 
REPITA
NOP
NOP
MOVLW	.0

MOVWF	OFFSET
MOVLW HIGH MUX
MOVWF	PCLATH
MOVF 	OFFSET,W
CALL	MUX
CLRF	PCLATH
 
 
MOVLW HIGH REPITA ;load high 8-bit address of Table
MOVWF  PCLATH ;into PCLATH
GOTO REPITA

;GOTO  0X805  ;REPITA	 
COMANDO BCF	PORTE,0		;RS=0 PARA MANDAR UN COMANDO
	GOTO	SIGALCD
DATO	BSF	PORTE,0		;RS=1 PARA MANDAR UN DATO
SIGALCD MOVWF	PORTD
	CALL	RETARDOLCD
	BSF	PORTE,1		;ENABLE=1
	CALL	RETARDOLCD	
	BCF	PORTE,1		;ENABLE=0
RETURN
	;GOTO CODIGO
	
RETARDOLCD   
	REG11 EQU 0X50
	REG21 EQU 0X51
	REG31 EQU 0X52
	MOVLW   .50
	MOVWF   REG11
REP31    MOVLW   .1
	MOVWF   REG21
REP21    MOVLW   .4
	MOVWF   REG31

REP11     CLRWDT
	DECFSZ  REG31
	GOTO    REP11
	DECFSZ  REG21
	GOTO    REP21	
	DECFSZ  REG11	
	GOTO    REP31	
			
RETURN	
 

MUX
	XORWF	VAR1,W
	BTFSS	STATUS,Z    ;IF VAR1==0{VAR1=W} 
	GOTO	$+5
	MOVFW	TEMPORAL
	MOVWF	VAR1
	CLRF	TEMPORAL
GOTO	CONTINUA
	MOVLW	.0
	XORWF	VAR2,W
	BTFSS	STATUS,Z    ;ELSIF VAR2==0{VAR2=W} 
	GOTO	$+5
	MOVFW	TEMPORAL
	MOVWF	VAR2
	CLRF	TEMPORAL
GOTO CONTINUA
	MOVLW	.0
	XORWF	VAR3,W
	BTFSS	STATUS,Z    ;ELSE{VAR3=W}
	GOTO	$+4
	MOVFW	TEMPORAL
	MOVWF	VAR3
	CLRF	TEMPORAL
CONTINUA	
	;- - - - - - - - - - -
       MOVFW	VAR1
       BSF	PORTA,3
       BCF	PORTA,4
       BCF	PORTA,5
       ANDLW	B'00001111'
;       MOVWF	OFFSET
;       MOVLW HIGH TABLA7SEG
;       MOVWF	PCLATH
;       MOVF 	OFFSET,W
       CALL	TABLA7SEG
;       CLRF	PCLATH
       
       MOVWF    PORTC
       CALL	LOAD_DATA
       CALL	DELAY
       CLRF	PORTC

       MOVFW	VAR2
       BCF	PORTA,3
       BSF	PORTA,4
       BCF	PORTA,5
       ANDLW	B'00001111'
;       MOVWF	OFFSET
;       MOVLW HIGH TABLA7SEG
;       MOVWF	PCLATH
;       MOVF 	OFFSET,W
      CALL	TABLA7SEG
;       CLRF	PCLATH
       MOVWF    PORTC
       CALL	LOAD_DATA
       CALL	DELAY
       CLRF	PORTC

       MOVFW	VAR3
       BCF	PORTA,3
       BCF	PORTA,4
       BSF	PORTA,5
       ANDLW	B'00001111'
       
;       MOVWF	OFFSET
;       MOVLW HIGH TABLA7SEG
;       MOVWF	PCLATH
;       MOVF 	OFFSET,W
      CALL	TABLA7SEG
;       CLRF	PCLATH
       
       MOVWF    PORTC
       CALL	LOAD_DATA
       CALL	DELAY
       CLRF	PORTC
	
RETURN    

RETARDO_TMR0
    BCF	    INTCON,T0IF
    CLRF    TMR0
 TEST_T0
    BTFSS   INTCON,T0IF
    GOTO    TEST_T0
RETURN   
		    		    		
  
DELAY;500ms   clk 0.125MHz
    DECFSZ	D1, F
    GOTO	$+2
    DECFSZ	D2, F
    GOTO	DELAY
    nop
RETURN
    
LOAD_DATA
    MOVLW	0x34
    MOVWF	D1
    MOVLW	0x0D
    MOVWF	D2
 RETURN
 
TABLA7SEG
    ADDWF PCL,F
    ;DT .63,.6,.91,.79,.102,.109,.125,.7,.127,.147,.0,.0,.0,.0,.0,.0,.0,.0,.0,.0,.0,.0,.0,.0,.0,.0,.0,.0,.0,.0,.0,.0,.0,.0,.0,.0,.0,.0,.0
    RETLW .63	 ;0
    RETLW .6	 ;1
    RETLW .91	 ;2
    RETLW .79	 ;3
    RETLW .102	 ;4
    RETLW .109	 ;5
    RETLW .125	 ;6
    RETLW .7	 ;7
    RETLW .127	 ;8
    RETLW .147	;9
    RETLW .119	;A
    RETLW .124	;B
    RETLW .57	;C
    RETLW .94	;D
    RETLW .121	;E
    RETLW .113	;F
    RETURN
    
   BTFSC INTCON,RBIF ;Interupcion portB?
   GOTO  INT_RB
   GOTO  FIN_INT
 END			

