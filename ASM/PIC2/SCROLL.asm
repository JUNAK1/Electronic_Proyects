;JUAN CAMILO SERRANO CORREA
    ;23/09/2021
 
;DESPLASA UN MENSAJE DE DERECHA A IZQUIERDA, PUEDE DESPLAZAR MUY FACILMENTE HASTA 255 CARACTERES!
;LA TABLA TIENE UN TAMAСO DE 59, EN LA PRIMERA ITERACION SE CARGAN LOS PRIMEROS 16 CARACTERES, DESPUES SE CONTINUA CON EL
;METODO DE LA VENTANA DESLIZANTE, ES DECIR, SE CARGAN LOS DATOS DEL 2 AL 17 DESPUES DEL 3 AL 18 AND SO ON
;CUANDO LLEGA 43 AL 59, EL MENSAJE HA TERMINADO Y COMIENZA TODO DE NUEVO.
;SE MUESTRA INDEFINIDAMENTE.
    
#include "p16f887.inc"

; CONFIG1
; __config 0x30F5
 __CONFIG _CONFIG1, _FOSC_INTRC_NOCLKOUT & _WDTE_OFF & _PWRTE_OFF & _MCLRE_ON & _CP_OFF & _CPD_OFF & _BOREN_OFF & _IESO_OFF & _FCMEN_OFF & _LVP_OFF
; CONFIG2
; __config 0x3FFF
 __CONFIG _CONFIG2, _BOR4V_BOR40V & _WRT_OFF
 
 CBLOCK 0X21
    VARIABLE1	    ;21 de memoria de datos
    TEMPORAL	    ;22 de memoria de datos
    VAR2
    W_TEMP	    ;REGISTRO PARA GUARDAR CONTEXTO W
    STATUS_TEMP	    ;REGISTRO PARA GUARDAR CONTEXTO REGISTRO STATUS
    TMR0_CONTADOR
    INTRB0_CONTADOR
    CONTADOR_RB
    UNIDAD
    DECENA
    CENTENA
    D_CONV
    SCROLL
    CONT
    SCROLL1
    D1
    D2
 ENDC

 ORG	0
 GOTO	INICIO
 ORG	10

 INICIO
    BANKSEL PORTB
    CLRF PORTB
    
 ;-----------------BANCO_3----------------------------------------
    BSF STATUS,5    ;PONGO EN ALTO EL BIT #5 DEL REGISTRO STATUS
    BSF STATUS,6    ;PONGO EN ALTO EL BIT #6 DEL REGISTRO STATUS CAMBIO AL BANCO#3
   
    CLRF ANSEL	    ;DEFINIR AN(7-0) COMO DIGITAL I/O
    CLRF ANSELH
 ;-----------------BANCO_1----------------------------------------
    BCF STATUS,6    ;CAMBIO AL BANCO 1
    
    CLRF TRISA	   
    CLRF TRISC 
    CLRF TRISB
    COMF TRISB,F
    CLRF TRISD
    CLRF TRISE
    BCF	 OSCCON,6	;125KHZ reloj interno
    BCF	 OSCCON,5
    BSF	 OSCCON,4
 ;-----------------BANCO_0----------------------------------------
    BCF STATUS,5   ;CAMBIO AL BANCO 0
    BCF STATUS,6   ;CAMBIO AL BANCO 0

    CLRF PORTB	
    CLRF PORTC
    CLRF PORTD
    CLRF PORTA
    CLRF PORTE
 ;----------------------------------------------------------------
MOVLW	0X0F
CALL	COMANDO
MOVLW	0X38	;INICIALIZACION LCD 
CALL	COMANDO
MOVLW	0X0C
CALL	COMANDO
 
MOVLW	0X01	;LIMPIA PANTALLA	
CALL	COMANDO 
MOVLW	0XC5	;UBICAR EL DATO SEGUNDA LINEA
CALL	COMANDO;LA LCD ES DE DOS FILAS
	
MOVLW	"U"
CALL	DATO
MOVLW	"P"
CALL	DATO
MOVLW	"T"
CALL	DATO
MOVLW	"C"
CALL	DATO

MOVLW	.16;;NUMERO DE COLUMNAS, EN ESTE CASO 16
MOVWF	SCROLL
MOVLW	.0
 
CODIGO	
 
MOVLW	0X80	;PRIMERA LINEA 
CALL	COMANDO
CALL	MY_NAME_IS
INCF	SCROLL
INCF	SCROLL1
MOVFW	SCROLL1
MOVWF	CONT

MOVLW	.59;TAMAСO DE LA TABLA
XORWF	SCROLL,W
BTFSS	STATUS,Z
GOTO	CODIGO
MOVLW	.16;NUMERO DE COLUMNAS, EN ESTE CASO 16
MOVWF	SCROLL
CLRF	CONT
CLRF	SCROLL1
GOTO    CODIGO
   
MY_NAME_IS
	MOVF	CONT,W
	CALL	DISPLAY
	CALL	DATO
	INCF	CONT
	MOVFW	SCROLL
	XORWF	CONT,W
	BTFSS	STATUS,Z;
	GOTO MY_NAME_IS
	CLRF CONT
	RETURN
	
COMANDO	BCF	PORTE,2	;RS=0 pARA MANDAR COMANDO
	GOTO SIGALCD
DATO	BSF	PORTE,2	;RS=1 PARA MANDAR DATO
SIGALCD	MOVWF	PORTD
	CALL LOAD_DATA
	CALL RETARDOLCD
	BSF PORTE,1	;ENABLE
	CALL LOAD_DATA
	CALL RETARDOLCD
	BCF PORTE,1	;ENABLE+
	RETURN
	
DISPLAY	;AQUI VA EL MENSAJE A DESPLAZAR, ELIMINE LOS PRIEMROS Y ULTIMOS 16 ESPACIOS SI QUIERE QUE EL MENSAJE PASE DE INMEDIATO 
    ADDWF PCL,F
    RETLW   .32;16 ESPACIOS PARA EL SCROLL
    RETLW   .32
    RETLW   .32
    RETLW   .32
    RETLW   .32
    RETLW   .32
    RETLW   .32
    RETLW   .32
    RETLW   "X"
    RETLW   .32
    RETLW   .32
    RETLW   .32
    RETLW   .32
    RETLW   .32
    RETLW   .32
    RETLW   .32
    RETLW   .32
    RETLW   "J"
    RETLW   "U"
    RETLW   "A"
    RETLW   "N"						      
    RETLW   .32
    RETLW   "C"
    RETLW   "A"
    RETLW   "M"						      
    RETLW   "I"
    RETLW   "L"
    RETLW   "O"
    RETLW   .32						       
    RETLW   "S"
    RETLW   "E"
    RETLW   "R"
    RETLW   "R"
    RETLW   "A"
    RETLW   "N"
    RETLW   "O"
    RETLW   .32
    RETLW   "C"
    RETLW   "O"
    RETLW   "R"
    RETLW   "R"
    RETLW   "E"
    RETLW   "A"
    RETLW   .32;16 ESPACIOS PARA TERMINAR EL MENSAJE COMPLETO Y COMENZAR DE NUEVO
    RETLW   .32
    RETLW   .32
    RETLW   .32
    RETLW   .32
    RETLW   .32
    RETLW   .32
    RETLW   "X"
    RETLW   .32
    RETLW   .32
    RETLW   .32
    RETLW   .32
    RETLW   .32
    RETLW   .32
    RETLW   .32
    RETLW   .32
    RETLW   .32

RETARDOLCD ;20ms   clk 4MHz
DECFSZ	D1, F
;GOTO	$+2
;DECFSZ	D2, F
GOTO	RETARDOLCD
nop
RETURN
LOAD_DATA
MOVLW	0XD0;9F
MOVWF	D1
;MOVLW	0x10
;MOVWF	D2
 RETURN
	

 END			
