;Juan Camilo Serrano Correa
;Aplicacion
; 25/08/2021
;El motor pap simula ser el motor de un ascensor, los leds van indicando cuanto falta para llegar al proximo piso
;El display 7 segmentos muestra el piso en el que acutalemte se encuentra, de repente el ascensor comienza 
;fallar y sube demaciado rapido, los pasajeros entran en panico!!!
;Existe un boton de emergencia, cuando este es presionado el ascensor para de inmediato
;Se habilita un piano electrico para que la persona dentro del ascensor pueda generar una melodia de SOS
;Existe una tecla del piano secreta que libera a las personas del ascensor  Podran encontrarla?
;Si la encuentran las puertas del ascensor se abren 
#include "p16f887.inc"
 __CONFIG _CONFIG1, _FOSC_INTRC_NOCLKOUT & _WDTE_OFF & _PWRTE_OFF & _MCLRE_ON & _CP_OFF & _CPD_OFF & _BOREN_ON & _IESO_ON & _FCMEN_ON & _LVP_ON
 __CONFIG _CONFIG2, _BOR4V_BOR40V & _WRT_OFF
 
 CBLOCK	0X21
 STEP1
 STEP2
 STEP3
 STEP4
 STEP5
 STEP6
 STEP7
 STEP8
 PAP_CONT
 CONT
  CONT1
 D1
 D2
 D3
 D11
 D22
 D33
 ENDC
 ORG	0
 GOTO	INICIO
 ORG	10
 INICIO
;PASOS PARA CONFIGURAR PORTB COMO i/o INPUT;;;;;;;;;
BSF STATUS,5
BSF STATUS,6  ;11
CLRF ANSEL;CLEAR todos los bits; EN 0 LOS PINES SON DE SALIDA
CLRF ANSELH
CLRF TRISB ;out
COMF TRISB ;in
BSF OPTION_REG,7; DESABILITA RESISTENCIA PULLUP
BSF INTCON,7; DESABILITA INTERRUPCIONES
;PUERTO D OUTPUT;;;;;;;;;;;;;;;;;;;;;;;;;;;;;;;;;;;;
BCF STATUS,6 ;01
CLRF TRISC
CLRF TRISE
CLRF TRISD
CLRF TRISA
BCF STATUS,5;00
CLRF PORTC
CLRF PORTD
CLRF PORTA
CLRF PORTE
MOVLW B'1000'; secuencia de medio pasos, 8 pasos del motor PAP
MOVWF STEP1
MOVLW B'1100'
MOVWF STEP2
MOVLW B'0100'
MOVWF STEP3
MOVLW B'0110'
MOVWF STEP4
MOVLW B'0010'
MOVWF STEP5
MOVLW B'0011'
MOVWF STEP6
MOVLW B'0001'
MOVWF STEP7
MOVLW B'1001'
MOVWF STEP8
 
LOOP
CALL	PAP 
INCF	CONT1
MOVFW	CONT1
MOVWF   PORTD
BTFSC   PORTD,6
CALL SHOW; #Piso actual
BTFSC  PORTB,0
;CLRF   CONT
CALL PIANO_EMERGENCY
   

GOTO LOOP 

 ;;;;;;;;;;;;;;;;;;;;;;;;;;;;;;;;;;;;;;;;;;;;;;;;;;;
PIANO_EMERGENCY
 BTFSS PORTB,0
 GOTO	$+6
 COMF PORTE,F
 CALL	LOAD_DATA_DO ;Antirebote__  XD	
 CALL	DELAY_DO
 BTFSC PORTB,0
 GOTO	$-4

 BTFSS PORTB,1
 GOTO	$+6
 COMF PORTE,F
 CALL	LOAD_DATA_RE ;Antirebote__  XD	
 CALL	DELAY_RE
 BTFSC PORTB,1
 GOTO	$-4
 
 BTFSS PORTB,2
 GOTO	$+6
 COMF PORTE,F
 CALL	LOAD_DATA_MI ;Antirebote__  XD	
 CALL	DELAY_MI
 BTFSC PORTB,2
 GOTO	$-4
 
 BTFSS PORTB,3
 GOTO	$+6
 COMF PORTE,F
 CALL	LOAD_DATA_FA ;Antirebote__  XD	
 CALL	DELAY_FA
 BTFSC PORTB,3
 GOTO	$-4
 
 BTFSS PORTB,4
 GOTO	$+6
 COMF PORTE,F
 CALL	LOAD_DATA_SOL ;Antirebote__  XD	
 CALL	DELAY_SOL
 BTFSC PORTB,4
 GOTO	$-4
 
 BTFSS PORTB,5
 GOTO	$+6
 COMF PORTE,F
 CALL	LOAD_DATA_LA ;Antirebote__  XD	
 CALL	DELAY_LA
 BTFSC PORTB,5
 GOTO	$-4
 
 BTFSS PORTB,6
 GOTO	$+6
 COMF PORTE,F
 CALL	LOAD_DATA_SI ;Antirebote__  XD	
 CALL	DELAY_SI
 BTFSC PORTB,6
 GOTO	$-4
 
 BTFSS PORTB,7
 GOTO	$+7
 COMF PORTE,F
 CALL	LOAD_DATA_DOO ;Antirebote__  XD	
 CALL  GO_AWAY
 CALL	DELAY_DOO
 BTFSC PORTB,7
 GOTO	$-4
 GOTO PIANO_EMERGENCY
 RETURN
DISPLAY
    ADDWF PCL,F
    DT 0X3F,0X3F,0X06,0X06,0X5B,0X5B,0X4F,0X4F,0X66,0X66,0X6D,0X6D,0X7D,0X7D,0X07,0X07,0X7F,0X7F,0X67,0X67,0X77,0X77,0X7C,0X7C,0X39,0X39,0X5E,0X5E,0X79,0X79,0X71,0X71;conteo de 0 to F
RETURN
SHOW
 INCF	CONT
 MOVF   CONT,W
 ANDLW	B'00001111';mascara, valores mayores a 15 no sirven
 CALL DISPLAY
 MOVWF	PORTC
 CLRF	PAP_CONT
RETURN
 ;;;;;;;;;;;;;;;;;;;;;;;;;;;;;;;;;;;;;;;;;;;;;;;;;;;
 GO_AWAY
 CLRF PORTD
 COMF PORTD
 CALL	LOAD_DATA1
 CALL DELAY1
 BCF PORTD,4
 BCF PORTD,3
 CALL	LOAD_DATA1
 CALL DELAY1
 BCF PORTD,5
 BCF PORTD,2
 CALL	LOAD_DATA1
 CALL DELAY1
  BCF PORTD,6
 BCF PORTD,1
 CALL	LOAD_DATA1
 CALL DELAY1
  BCF PORTD,7
 BCF PORTD,0
 CALL	LOAD_DATA1
 CALL DELAY1
 RETURN
 ;-----------------------------------------------
 DELAY1;1s   clk 4MHz
DECFSZ	D11, F
GOTO	$+2
DECFSZ	D22, F
GOTO	$+2
DECFSZ  D33,F
GOTO	DELAY1
nop
RETURN
LOAD_DATA1
MOVLW	0x08
MOVWF	D11
MOVLW	0x2F
MOVWF	D22
MOVLW   0x03
MOVWF   D33
 RETURN
;----------------------------------------------- 
DELAY;100ms   clk 4MHz
DECFSZ	D1, F
GOTO	$+2
DECFSZ	D2, F
GOTO	DELAY
nop
RETURN
LOAD_DATA
MOVLW	0x1F
MOVWF	D1
MOVLW	0x4F
MOVWF	D2
 RETURN
 
DELAY_DO
DECFSZ	D1, F
GOTO	$+2
DECFSZ	D2, F
GOTO	DELAY_DO
nop
RETURN
LOAD_DATA_DO
MOVLW	0x75
MOVWF	D1
MOVLW	0x08
MOVWF	D2 
 RETURN
DELAY_RE
DECFSZ	D1, F
GOTO	$+2
DECFSZ	D2, F
GOTO	DELAY_RE
nop
RETURN
LOAD_DATA_RE
MOVLW	0xA6
MOVWF	D1
MOVLW	0x07
MOVWF	D2 
RETURN

DELAY_MI
DECFSZ	D1, F
GOTO	$+2
DECFSZ	D2, F
GOTO	DELAY_MI
nop
RETURN
LOAD_DATA_MI
MOVLW	0xEC
MOVWF	D1
MOVLW	0x06
MOVWF	D2 
RETURN
DELAY_FA
DECFSZ	D1, F
GOTO	$+2
DECFSZ	D2, F
GOTO	DELAY_FA
nop
RETURN
LOAD_DATA_FA
MOVLW	0x97
MOVWF	D1
MOVLW	0x06
MOVWF	D2 
RETURN
DELAY_SOL
DECFSZ	D1, F
GOTO	$+2
DECFSZ	D2, F
GOTO	DELAY_SOL
nop
RETURN
LOAD_DATA_SOL
MOVLW	0xFA
MOVWF	D1
MOVLW	0x05
MOVWF	D2 
RETURN
DELAY_LA
DECFSZ	D1, F
GOTO	$+2
DECFSZ	D2, F
GOTO	DELAY_LA
nop
RETURN
LOAD_DATA_LA
MOVLW	0x6F
MOVWF	D1
MOVLW	0x05
MOVWF	D2 
RETURN
DELAY_SI
DECFSZ	D1, F
GOTO	$+2
DECFSZ	D2, F
GOTO	DELAY_SI
nop
RETURN
LOAD_DATA_SI
MOVLW	0xF3
MOVWF	D1
MOVLW	0x04
MOVWF	D2 
RETURN
DELAY_DOO
DECFSZ	D1, F
GOTO	$+2
DECFSZ	D2, F
GOTO	DELAY_DOO
nop
RETURN
LOAD_DATA_DOO
MOVLW	0xBB
MOVWF	D1
MOVLW	0x04
MOVWF	D2 
RETURN
 
;;;;;;;;;;;;;;;;;;;;;;;;;;;;;;;;;;;;;;;;;;;;;;;;;;;
PAP; Sentido horario
 MOVFW STEP1
 MOVWF PORTA;se carga el primer paso del motor pap
 CALL	LOAD_DATA; se encargan los datos para ejecutar el delay
 CALL DELAY	 ;se ejecuta el delay
 MOVFW STEP2
 MOVWF PORTA;se carga el segundo paso del motor pap
 CALL	LOAD_DATA
 CALL DELAY
 MOVFW STEP3
 MOVWF PORTA
 CALL	LOAD_DATA
 CALL DELAY
 MOVFW STEP4
 MOVWF PORTA
 CALL	LOAD_DATA
 CALL DELAY
 MOVFW STEP5
 MOVWF PORTA
 CALL	LOAD_DATA
 CALL DELAY
 MOVFW STEP6
 MOVWF PORTA
 CALL	LOAD_DATA
 CALL DELAY
 MOVFW STEP7
 MOVWF PORTA
 CALL	LOAD_DATA
 CALL DELAY
 MOVFW STEP8
 MOVWF PORTA
 CALL	LOAD_DATA
 CALL DELAY
 MOVFW PAP_CONT
 RETURN
END