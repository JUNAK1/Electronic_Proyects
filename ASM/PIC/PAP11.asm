;Juan Camilo Serrano Correa
;Motor paso a paso
; 1/08/2021
#include "p16f887.inc"
 __CONFIG _CONFIG1, _FOSC_INTRC_NOCLKOUT & _WDTE_OFF & _PWRTE_OFF & _MCLRE_ON & _CP_OFF & _CPD_OFF & _BOREN_ON & _IESO_ON & _FCMEN_ON & _LVP_ON
 __CONFIG _CONFIG2, _BOR4V_BOR40V & _WRT_OFF
 CBLOCK 0X22
 STEP1
 STEP2
 STEP3
 STEP4
 STEP5
 STEP6
 STEP7
 STEP8
 PAP_CONT
 CONT
 D1
 D2
 C64
 ENDC
 ORG	0
 GOTO	INICIO
 ORG	10
 INICIO
;PASOS PARA CONFIGURAR PORTB COMO i/o INPUT;;;;;;;;;
BSF STATUS,5
BSF STATUS,6  ;11
CLRF ANSEL;CLEAR todos los bits; EN 0 LOS PINES SON DE SALIDA
CLRF ANSELH
CLRF TRISB ;out
COMF TRISB ;in
BSF OPTION_REG,7; HABILITA RESISTENCIA PULLUP
BSF INTCON,7; DESABILITA INTERRUPCIONES
;PUERTO D OUTPUT;;;;;;;;;;;;;;;;;;;;;;;;;;;;;;;;;;;;
BCF STATUS,6 ;01
CLRF TRISC
CLRF TRISD
CLRF TRISA
CLRF TRISE
BCF STATUS,5;00
CLRF PORTC
CLRF PORTD
CLRF PORTA
CLRF PORTE
;CLRWDT
BSF PORTE,0;LED ON, CONFIRMA ENCENDIDO DEL PIC
BSF PORTC,0
BSF PORTC,4 
;;;;;;;;;;;;;;;;;;;;;;;;;;;;;;;;;;;;;;;;;;;;;;;;;;;; 
MOVLW B'1000'; secuencia de medio pasos, 8 pasos del motor PAP
MOVWF STEP1
MOVLW B'1100'
MOVWF STEP2
MOVLW B'0100'
MOVWF STEP3
MOVLW B'0110'
MOVWF STEP4
MOVLW B'0010'
MOVWF STEP5
MOVLW B'0011'
MOVWF STEP6
MOVLW B'0001'
MOVWF STEP7
MOVLW B'1001'
MOVWF STEP8
;;;;;;;;;;;;;;;;;;;;;;;;;;;;;;;;;;;;;;;;;;;;;;;;;;;
LOOP;512
BTFSC PAP_CONT,7 ;SI EL BIT(6)=1 => HEX=PAP_CONT=64 = 1vuelta
CALL  SHOW     ;Mostrar en display 7 seg
BTFSC PORTB,0	;Bit Test f, Skip if Set  
GOTO RR
CALL NPAP ; Sentido antihorario
GOTO LOOP
RR
CALL PAP; Sentido horario
GOTO LOOP
;;;;;;;;;;;;;;;;;;;;;;;;;;;;;;;;;;;;;;;;;;;;;;;;;;;
PAP; Sentido horario
 MOVFW STEP1
 MOVWF PORTA;se carga el primer paso del motor pap
 CALL	LOAD_DATA; se encargan los datos para ejecutar el delay
 CALL DELAY	 ;se ejecuta el delay
 MOVFW STEP2
 MOVWF PORTA;se carga el segundo paso del motor pap
 CALL	LOAD_DATA
 CALL DELAY
 MOVFW STEP3
 MOVWF PORTA
 CALL	LOAD_DATA
 CALL DELAY
 MOVFW STEP4
 MOVWF PORTA
 CALL	LOAD_DATA
 CALL DELAY
 MOVFW STEP5
 MOVWF PORTA
 CALL	LOAD_DATA
 CALL DELAY
 MOVFW STEP6
 MOVWF PORTA
 CALL	LOAD_DATA
 CALL DELAY
 MOVFW STEP7
 MOVWF PORTA
 CALL	LOAD_DATA
 CALL DELAY
 MOVFW STEP8
 MOVWF PORTA
 CALL	LOAD_DATA
 CALL DELAY
 MOVFW PAP_CONT
 MOVWF PORTE,0
 RETURN
;;;;;;;;;;;;;;;;;;;;;;;;;;;;;;;;;;;;;;;;;;;;;;;;;;;
NPAP; sentido antiorario
 MOVFW STEP8
 MOVWF PORTA
 CALL	LOAD_DATA
 CALL DELAY
 MOVFW STEP7
 MOVWF PORTA
 CALL	LOAD_DATA
 CALL DELAY
 MOVFW STEP6
 MOVWF PORTA
 CALL	LOAD_DATA
 CALL DELAY
 MOVFW STEP5
 MOVWF PORTA
 CALL	LOAD_DATA
 CALL DELAY
 MOVFW STEP4
 MOVWF PORTA
 CALL	LOAD_DATA
 CALL DELAY
 MOVFW STEP3
 MOVWF PORTA
 CALL	LOAD_DATA
 CALL DELAY
 MOVFW STEP2
 MOVWF PORTA
 CALL	LOAD_DATA
 CALL DELAY
 MOVFW STEP1
 MOVWF PORTA
 CALL	LOAD_DATA
 CALL DELAY
 MOVFW PAP_CONT
 MOVWF PORTE,0
 RETURN
;;;;;;;;;;;;;;;;;;;;;;;;;;;;;;;;;;;;;;;;;;;;;;;;;;;
DELAY;10ms   clk 4MHz
DECFSZ	D1, F
GOTO	$+2
DECFSZ	D2, F
GOTO	DELAY
nop
RETURN
LOAD_DATA
MOVLW	0xCF
MOVWF	D1
MOVLW	0x08
MOVWF	D2
 RETURN
;;;;;;;;;;;;;;;;;;;;;;;;;;;;;;;;;;;;;;;;;;;;;;;;;;;
DISPLAY
    ADDWF PCL,F
    DT 0X3F,0X3F,0X06,0X06,0X5B,0X5B,0X4F,0X4F,0X66,0X66,0X6D,0X6D,0X7D,0X7D,0X07,0X07,0X7F,0X7F,0X67,0X67,0X77,0X77,0X7C,0X7C,0X39,0X39,0X5E,0X5E,0X79,0X79,0X71,0X71;conteo de 0 to F
RETURN
SHOW
 INCF	CONT
 MOVF   CONT,W
 ANDLW	B'00011111';mascara, valores mayores a 15 no sirven
 CALL DISPLAY
 MOVWF	PORTC
 CLRF	PAP_CONT
;;;;;;;;;;;;;;;;;;;;;;;;;;;;;;;;;;;;;;;;;;;;;;;;;;;
RETURN
END